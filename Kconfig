## Kconfig
```kconfig
mainmenu "NPC Configuration Menu"

menu "ISA setting"

config MBASE
  hex "Memory base address"
  default 0x80000000

config MSIZE
  hex "Memory size"
  default 0x8000000

config TIME
  bool "Enable time"
  default y

endmenu

menu "Verilator setting"

config VCD
  bool "Enable wave trace"
  default y

endmenu

menu "Trace and difftest"

config TRACE
  bool "Enable tracer"
  default y

config ITRACE
  depends on TRACE
  bool "Enable instruction tracer"
  default y

config ITRACE_COND
  depends on ITRACE
  bool "Enable instruction recording"
  default y

config MTRACE
  depends on TRACE 
  bool "Enable mtrace"
  default n

config FTRACE
  depends on TRACE 
  bool "Enable ftrace"
  default n

config DTRACE
  depends on TRACE
  bool "Enable dtrace"
  default n

config DIFFTEST
  bool "Enable differential testing"
  default y

endmenu

menu "Debugging and log"

config WATCHPOINT
  bool "Enable watchpoint"
  default n
 
config LOG
  bool "Enable log"
  default y

endmenu
```
